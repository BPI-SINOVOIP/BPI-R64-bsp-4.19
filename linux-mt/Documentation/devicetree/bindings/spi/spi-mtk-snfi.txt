## linux-mt/Documentation/devicetree/bindings/spi/spi-mtk-snfi.txt
```
MediaTek SoCs SPI NAND FLASH interface (SNFI) DT binding

This file documents the device tree bindings for MTK SoCs SPI NAND controller.
Note that Parallel Nand and SPI NAND is alternative on MTK SoCs.

Required properties:
- compatible:		should be "mediatek,mt7622-snfi"
- reg:			base physical address and size of SNFI.
- interrupts:		interrupts of SNFI.
- clocks:		SNFI required clocks.
- clock-names:		SNFI clocks internal names.
- #address-cells:	NAND chip index, should be 1.
- #size-cells:		Should be 0.

Example:
	snfi: spi@1100d000 {
		compatible = "mediatek,mt7622-snfi";
		reg = <0 0x1100d000 0 0x1000>;
		interrupts = <GIC_SPI 96 IRQ_TYPE_LEVEL_LOW>;
		clocks = <&pericfg CLK_PERI_NFI_PD>,
			 <&pericfg CLK_PERI_SNFI_PD>;
		clock-names = "nfi_clk", "spi_clk";
		ecc-engine = <&bch>;
		#address-cells = <1>;
		#size-cells = <0>;
	};

Subnodes properties:
- Should use spi-nand framework, see Documentation/devicetree/bindings/mtd/spi-nand.txt

Example:
&snfi {
	pinctrl-names = "default";
	pinctrl-0 = <&serial_nand_pins>;
	status = "okay";

	spi_nand@0 {
		#address-cells = <1>;
		#size-cells = <1>;
		compatible = "spi-nand";
		spi-max-frequency = <104000000>;
		reg = <0>;
	};
};
```

## proprietary_driver/config.in
```kconfig
mainmenu_option next_comment
comment 'Proprietary Kernel Modules'

bool 'Proprietary modules'      CONFIG_PROPRIETARY_MODULES
if [ "$CONFIG_PROPRIETARY_MODULES" = "y" ]; then
bool 'Cryptodev'                CONFIG_PROPRIETARY_MODULES_CRYPTODEV
bool 'UFSD (Paragon)'           CONFIG_PROPRIETARY_MODULES_UFSD
bool 'WiFi Forward Module' 	CONFIG_PROPRIETARY_MODULES_WIFI_FORWARD
if [ "$CONFIG_PROPRIETARY_MODULES_WIFI_FORWARD" = "y" ]; then
choice	'WiFi Forward Version'\
	"WiFiForward	CONFIG_PROPRIETARY_MODULES_WIFI_FWD\
	WiFi_Forward(v1)	CONFIG_PROPRIETARY_MODULES_WIFI_FWD_V1
	"
fi

fi
endmenu
```

## u-boot-mt/config.in
```kconfig
mainmenu_name 'Uboot Configuration'

choice 'Chip ID'	 "MT7623 MT7623 \
                    MT7622 MT7622 \
					MT7626 MT7626
                   " MT7622

choice 'Chip Type' "FPGA FPGA \
                    ASIC ASIC
                   " ASIC

if [ "$MT7623" = "y" ]; then
   if [ "$FPGA" = "y" ]; then
       define_bool MT7623_FPGA_BOARD y
	   define_bool MT7622_FPGA_BOARD n
	   define_bool MT7626_FPGA_BOARD n
   else
       define_bool MT7623_ASIC_BOARD y
	   define_bool MT7622_ASIC_BOARD n
	   define_bool MT7626_ASIC_BOARD n
   fi
fi

if [ "$MT7622" = "y" ]; then
   if [ "$FPGA" = "y" ]; then
       define_bool MT7622_FPGA_BOARD y
	   define_bool MT7623_FPGA_BOARD n
	   define_bool MT7626_FPGA_BOARD n
   else
       define_bool MT7622_ASIC_BOARD y
	   define_bool MT7623_ASIC_BOARD n
	   define_bool MT7626_ASIC_BOARD n
   fi
fi

if [ "$MT7626" = "y" ]; then
   if [ "$FPGA" = "y" ]; then
       define_bool MT7626_FPGA_BOARD y
	   define_bool MT7622_FPGA_BOARD n
	   define_bool MT7623_FPGA_BOARD n
   else
       define_bool MT7626_ASIC_BOARD y
	   define_bool MT7622_ASIC_BOARD n
	   define_bool MT7623_ASIC_BOARD n
   fi
fi

#########################################################################################3
# MT7623
#########################################################################################3
if [ "$MT7623_FPGA_BOARD" = "y" -o "$MT7623_ASIC_BOARD" = "y" ]; then

#-----------------------
# MT7623 FLASH
#-----------------------
choice 'Flash Type' "NAND ON_BOARD_NAND_FLASH_COMPONENT \
                     SPI ON_BOARD_SPI_FLASH_COMPONENT \
                     eMMC ON_BOARD_EMMC_COMPONENT \
                     SD OFF_BOARD_SD_CARD_COMPONENT 
		    " eMMC

if [ "$ON_BOARD_NAND_FLASH_COMPONENT" = "y" ]; then
define_bool CONFIG_MTK_MTD_NAND y
define_bool CONFIG_MTK_SLC_NAND_SUPPORT y
fi

#-----------------------
# MT7623 Ethernet
#-----------------------			
choice 'Use GE1 or GE2' "GMAC1 CONFIG_USE_GE1  \
	                 GMAC2 CONFIG_USE_GE2
			" GMAC1
if [ "$CONFIG_USE_GE1" = "y" ]; then
choice 'GE1 connected to' "GE_MII_FORCE_100	 GE_MII_FORCE_100 \
		           GE_RVMII_FORCE_100    GE_RVMII_FORCE_100 \
		  	   GE_MII_AN		 GE_MII_AN \
		           GE_RGMII_FORCE_1000   GE_RGMII_FORCE_1000 \
		           GE_RGMII_AN		 GE_RGMII_AN \
			   GE_TRGMII_FORCE_2600  CONFIG_GE1_TRGMII_FORCE_2600
			  " GE_MII_FORCE_100
else
choice 'GE2 connected to' " GE_MII_FORCE_100		GE_MII_FORCE_100 \
			    GE_RVMII_FORCE_100		GE_RVMII_FORCE_100 \
  			    GE_MII_AN			GE_MII_AN \
			    GE_RGMII_FORCE_1000		GE_RGMII_FORCE_1000 \
			    GE_RGMII_AN			GE_RGMII_AN \
			    GE_RGMII_INTERNAL_P0_AN	GE_RGMII_INTERNAL_P0_AN \
			    GE_RGMII_INTERNAL_P4_AN	GE_RGMII_INTERNAL_P4_AN 
			   " GE_MII_FORCE_100
fi

if [ "$GE_MII_AN" = "y" -a "$CONFIG_USE_GE1" = "y" ]; then
    hex "10/100 PHY address for Auto Polling" MAC_TO_GIGAPHY_MODE_ADDR 0x1e
fi
if [ "$GE_MII_AN" = "y" -a "$CONFIG_USE_GE2" = "y" ]; then
    hex "10/100 PHY address for Auto Polling" MAC_TO_GIGAPHY_MODE_ADDR 0x1f
fi

if [ "$GE_RGMII_AN" = "y" -a "$CONFIG_USE_GE1" = "y" ]; then
    if [ "$MT7623_FPGA_BOARD" = "y" ]; then
        hex "GigaPHY address for Auto Polling" MAC_TO_GIGAPHY_MODE_ADDR 0x5
    else
        hex "GigaPHY address for Auto Polling" MAC_TO_GIGAPHY_MODE_ADDR 0x1e
    fi
fi
if [ "$GE_RGMII_AN" = "y" -a "$CONFIG_USE_GE2" = "y" ]; then
    if [ "$MT7623_FPGA_BOARD" = "y" ]; then
        hex "GigaPHY address for Auto Polling" MAC_TO_GIGAPHY_MODE_ADDR 0x6
    else
        hex "GigaPHY address for Auto Polling" MAC_TO_GIGAPHY_MODE_ADDR 0x1f
    fi
fi

if [ "$GE_RGMII_INTERNAL_P0_AN" = "y" -a "$CONFIG_USE_GE2" = "y" ]; then
    define_hex   MAC_TO_GIGAPHY_MODE_ADDR 0x0
fi

if [ "$GE_RGMII_INTERNAL_P4_AN" = "y" -a "$CONFIG_USE_GE2" = "y" ]; then
    define_hex   MAC_TO_GIGAPHY_MODE_ADDR 0x4
fi
	
fi



#########################################################################################3
# MT7622
#########################################################################################3
if [ "$MT7622_FPGA_BOARD" = "y" -o "$MT7622_ASIC_BOARD" = "y" ]; then

#-----------------------
# MT7622 FLASH
#-----------------------
choice 'Flash Type' "NAND ON_BOARD_NAND_FLASH_COMPONENT \
                     SNAND ON_BOARD_SPI_NAND_FLASH_COMPONENT \
                     SNOR ON_BOARD_SPI_NOR_FLASH_COMPONENT \
                     eMMC ON_BOARD_EMMC_COMPONENT \
                     SD OFF_BOARD_SD_CARD_COMPONENT \
					 NONE ON_BOARD_NO_FLASH_COMPONENT
		    " SNAND

if [ "$ON_BOARD_NAND_FLASH_COMPONENT" = "y" ]; then
define_bool CONFIG_MTK_MTD_NAND y
define_bool CONFIG_MTK_SLC_NAND_SUPPORT y
fi

if [ "$ON_BOARD_SPI_NAND_FLASH_COMPONENT" = "y" ]; then
define_bool CONFIG_MTK_MTD_NAND y
define_bool CONFIG_MTK_SLC_NAND_SUPPORT y
define_bool CONFIG_MTK_SPI_NAND_SUPPORT y
fi

#-----------------------
# MT7622 DDR
#-----------------------
choice 'DDR Component' " 512Mb ON_BOARD_512Mb_DRAM_COMPONENT \
			1024Mb ON_BOARD_1024Mb_DRAM_COMPONENT \
			2048Mb ON_BOARD_2048Mb_DRAM_COMPONENT \
			4096Mb ON_BOARD_4096Mb_DRAM_COMPONENT \
			8192Mb ON_BOARD_8192Mb_DRAM_COMPONENT
			" 4096Mb

#-----------------------
# MT7622 Ethernet
#-----------------------			
choice 'Use GE1 or GE2' "GMAC1 CONFIG_USE_GE1  \
	                 GMAC2 CONFIG_USE_GE2
			" GMAC2
if [ "$CONFIG_USE_GE1" = "y" ]; then
choice 'GE1 connected to' "GE_MII_FORCE_100	 GE_MII_FORCE_100 \
		           GE_RVMII_FORCE_100    GE_RVMII_FORCE_100 \
		  	   GE_MII_AN		 GE_MII_AN \
		           GE_RGMII_FORCE_1000   GE_RGMII_FORCE_1000 \
		           GE_RGMII_AN		 GE_RGMII_AN \
			   GE_TRGMII_FORCE_2600  CONFIG_GE1_TRGMII_FORCE_2600 \
			   GE_SGMII_FORCE_2500	 CONFIG_GE1_SGMII_FORCE_2500 \
			   GE_ESW	 	 CONFIG_GE1_ESW
			  " GE_RGMII_AN
else
choice 'GE2 connected to' " GE_MII_FORCE_100		GE_MII_FORCE_100 \
			    GE_RVMII_FORCE_100		GE_RVMII_FORCE_100 \
  			    GE_MII_AN			GE_MII_AN \
			    GE_RGMII_FORCE_1000		GE_RGMII_FORCE_1000 \
			    GE_RGMII_AN			GE_RGMII_AN \
			    GE_RGMII_INTERNAL_P0_AN	GE_RGMII_INTERNAL_P0_AN \
			    GE_RGMII_INTERNAL_P4_AN	GE_RGMII_INTERNAL_P4_AN 
			   " GE_RGMII_AN
fi

if [ "$GE_MII_AN" = "y" -a "$CONFIG_USE_GE1" = "y" ]; then
    hex "10/100 PHY address for Auto Polling" MAC_TO_GIGAPHY_MODE_ADDR 0x1e
fi
if [ "$GE_MII_AN" = "y" -a "$CONFIG_USE_GE2" = "y" ]; then
    hex "10/100 PHY address for Auto Polling" MAC_TO_GIGAPHY_MODE_ADDR 0x1f
fi

if [ "$GE_RGMII_AN" = "y" -a "$CONFIG_USE_GE1" = "y" ]; then
    if [ "$MT7622_FPGA_BOARD" = "y" ]; then
        hex "GigaPHY address for Auto Polling" MAC_TO_GIGAPHY_MODE_ADDR 0x5
    else
        hex "GigaPHY address for Auto Polling" MAC_TO_GIGAPHY_MODE_ADDR 0x1e
    fi
fi
if [ "$GE_RGMII_AN" = "y" -a "$CONFIG_USE_GE2" = "y" ]; then
    if [ "$MT7622_FPGA_BOARD" = "y" ]; then
        hex "GigaPHY address for Auto Polling" MAC_TO_GIGAPHY_MODE_ADDR 0x6
    else
        hex "GigaPHY address for Auto Polling" MAC_TO_GIGAPHY_MODE_ADDR 0x1f
    fi
fi

if [ "$GE_RGMII_INTERNAL_P0_AN" = "y" -a "$CONFIG_USE_GE2" = "y" ]; then
    define_hex   MAC_TO_GIGAPHY_MODE_ADDR 0x0
fi

if [ "$GE_RGMII_INTERNAL_P4_AN" = "y" -a "$CONFIG_USE_GE2" = "y" ]; then
    define_hex   MAC_TO_GIGAPHY_MODE_ADDR 0x4
fi

if [ "$CONFIG_GE1_SGMII_FORCE_2500" = "y" ]; then
    define_bool CONFIG_RTL8367 y
fi

fi


#########################################################################################3
# MT7626
#########################################################################################3
if [ "$MT7626_FPGA_BOARD" = "y" -o "$MT7626_ASIC_BOARD" = "y" ]; then

#-----------------------
# MT7626 FLASH
#-----------------------
choice 'Flash Type' "SNAND ON_BOARD_SPI_NAND_FLASH_COMPONENT \
                     SNOR ON_BOARD_SPI_NOR_FLASH_COMPONENT \
					 NONE ON_BOARD_NO_FLASH_COMPONENT
		    " SNAND

if [ "$ON_BOARD_SPI_NAND_FLASH_COMPONENT" = "y" ]; then
define_bool CONFIG_MTK_MTD_NAND y
define_bool CONFIG_MTK_SLC_NAND_SUPPORT y
define_bool CONFIG_MTK_SPI_NAND_SUPPORT y
fi

#-----------------------
# MT7626 DDR
#-----------------------
choice 'DDR Component' " 512Mb ON_BOARD_512Mb_DRAM_COMPONENT \
			1024Mb ON_BOARD_1024Mb_DRAM_COMPONENT \
			2048Mb ON_BOARD_2048Mb_DRAM_COMPONENT \
			4096Mb ON_BOARD_4096Mb_DRAM_COMPONENT \
			8192Mb ON_BOARD_8192Mb_DRAM_COMPONENT
			" 4096Mb

#-----------------------
# MT7626 Ethernet
#---------------------
choice 'Use GE1 or GE2' "GMAC1 CONFIG_USE_GE1  \
	                 GMAC2 CONFIG_USE_GE2
			" GMAC2
if [ "$CONFIG_USE_GE1" = "y" ]; then
choice 'GE1 connected to' "GE_MII_FORCE_100	 GE_MII_FORCE_100 \
		           GE_RVMII_FORCE_100    GE_RVMII_FORCE_100 \
			   GE_MII_AN		 GE_MII_AN \
		           GE_RGMII_FORCE_1000   GE_RGMII_FORCE_1000 \
		           GE_RGMII_AN		 GE_RGMII_AN \
			   GE_TRGMII_FORCE_2600  CONFIG_GE1_TRGMII_FORCE_2600 \
			   GE_SGMII_FORCE_2500	 CONFIG_GE1_SGMII_FORCE_2500 \
			   GE_ESW	 	 CONFIG_GE1_ESW
			  " GE_RGMII_AN
else
choice 'GE2 connected to' " GE_MII_FORCE_100		GE_MII_FORCE_100 \
			    GE_RVMII_FORCE_100		GE_RVMII_FORCE_100 \
			    GE_MII_AN			GE_MII_AN \
			    GE_RGMII_FORCE_1000		GE_RGMII_FORCE_1000 \
			    GE_RGMII_AN			GE_RGMII_AN \
			    GE_RGMII_INTERNAL_P0_AN	GE_RGMII_INTERNAL_P0_AN \
			    GE_RGMII_INTERNAL_P4_AN	GE_RGMII_INTERNAL_P4_AN
			   " GE_RGMII_AN
fi

if [ "$GE_MII_AN" = "y" -a "$CONFIG_USE_GE1" = "y" ]; then
    hex "10/100 PHY address for Auto Polling" MAC_TO_GIGAPHY_MODE_ADDR 0x1e
fi
if [ "$GE_MII_AN" = "y" -a "$CONFIG_USE_GE2" = "y" ]; then
    hex "10/100 PHY address for Auto Polling" MAC_TO_GIGAPHY_MODE_ADDR 0x1f
fi

if [ "$GE_RGMII_AN" = "y" -a "$CONFIG_USE_GE1" = "y" ]; then
    if [ "$MT7626_FPGA_BOARD" = "y" ]; then
        hex "GigaPHY address for Auto Polling" MAC_TO_GIGAPHY_MODE_ADDR 0x5
    else
        hex "GigaPHY address for Auto Polling" MAC_TO_GIGAPHY_MODE_ADDR 0x1e
    fi
fi
if [ "$GE_RGMII_AN" = "y" -a "$CONFIG_USE_GE2" = "y" ]; then
    if [ "$MT7626_FPGA_BOARD" = "y" ]; then
        hex "GigaPHY address for Auto Polling" MAC_TO_GIGAPHY_MODE_ADDR 0x6
    else
        hex "GigaPHY address for Auto Polling" MAC_TO_GIGAPHY_MODE_ADDR 0x1f
    fi
fi

if [ "$GE_RGMII_INTERNAL_P0_AN" = "y" -a "$CONFIG_USE_GE2" = "y" ]; then
    define_hex   MAC_TO_GIGAPHY_MODE_ADDR 0x0
fi

if [ "$GE_RGMII_INTERNAL_P4_AN" = "y" -a "$CONFIG_USE_GE2" = "y" ]; then
    define_hex   MAC_TO_GIGAPHY_MODE_ADDR 0x4
fi

if [ "$CONFIG_GE1_SGMII_FORCE_2500" = "y" ]; then
    define_bool CONFIG_RTL8367 y
fi

fi

#choice 'Default Behavior when Kernel Boot up Fail' "None None \
#			 FW_UPGRADE_BY_USB FW_UPGRADE_BY_USB \
#			 FW_UPGRADE_BY_SDXC FW_UPGRADE_BY_SDXC \
#			 FW_UPGRADE_BY_WEBUI FW_UPGRADE_BY_WEBUI \
#			 DUAL_IMAGE_SUPPORT DUAL_IMAGE_SUPPORT 
#			"

#Load Kernel Image from a USB Storage Device \
#Load Kernel Image from a SD card
#Load Kernel Image from a Browser \
#Load Kernel Image from the System Recovery Partition \
```
